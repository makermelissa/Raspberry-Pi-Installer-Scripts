/*
 * Device Tree overlay for the TSC2007 
 * touch screen controller on the Adafruit PiTFT
 *
 */


/dts-v1/;
/plugin/;
 
/ {
        compatible = "brcm,bcm2835";
 
        fragment@0 {
                target = <&i2c1>;
                __overlay__ {
                        #address-cells = <1>;
                        #size-cells = <0>;
                        status = "okay";
 
                        tsc2007: tsc2007@48 {
                                compatible = "ti,tsc2007";
                                reg = <0x48>;
                                interrupt-parent = <&gpio4>;
                                interrupts = <0 0x8>; /* falling edge */
                                gpios = <&gpio4 0 0>;
                                ti,x-plate-ohms = <180>;
                        };
                };
        };

    /*__overrides__ {
        touch-max-rt = <&tsc2007>,"ti,max-rt?";
        touch-fuzzx = <&tsc2007>,"ti,fuzzx?";
        touch-fuzzy  = <&tsc2007>,"ti,fuzzy?";
        touch-fuzzz  = <&tsc2007>,"ti,fuzzz?";
        touch-poll-period = <&tsc2007>,"ti,poll-period?";
    };*/
};